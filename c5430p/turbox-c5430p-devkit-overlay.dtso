// SPDX-License-Identifier: BSD-3-Clause
/*
 * Copyright (c) 2024 Thundercomm, Inc. All rights reserved.
 */

/dts-v1/;
/plugin/;

#include "turbox-c5430p-devkit-graphic.dtsi"
#include "turbox-c5430p-devkit-display.dtsi"
#include "turbox-c5430p-devkit-camera.dtsi"
#include "turbox-c5430p-devkit-bt.dtsi"
#include "turbox-c5430p-devkit-wlan.dtsi"

/ {
	model = "Thundercomm, Inc. Turbox C6490P devkit";
	compatible = "qcom,qcm6490-idp", "qcom,qcm6490";
};